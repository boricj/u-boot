## board/hp/hp_prime/Kconfig
```kconfig
if TARGET_HP_PRIME

config SYS_BOARD
	default "hp_prime"

config SYS_VENDOR
	default "hp"

config SYS_SOC
	default "s3c24x0"

config SYS_CONFIG_NAME
	default "hp_prime"

endif
```

## configs/hp_prime_defconfig
```kconfig
CONFIG_ARM=y
CONFIG_TARGET_HP_PRIME=y
CONFIG_SYS_PROMPT="hp_prime # "
# CONFIG_CMD_SETEXPR is not set
```
